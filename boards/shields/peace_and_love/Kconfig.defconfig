## boards/shields/peace_and_love/Kconfig.defconfig
```kconfig
if SHIELD_PEACE_AND_LOVE_LEFT

# Name must be less than 16 characters long!
config ZMK_KEYBOARD_NAME
    default "Peace and Love"

config ZMK_SPLIT_ROLE_CENTRAL
    default y

endif

if SHIELD_PEACE_AND_LOVE_LEFT || SHIELD_PEACE_AND_LOVE_RIGHT

config ZMK_SPLIT
    default y

endif
```

## boards/shields/peace_and_love/Kconfig.shield
```kconfig
# No whitespace after the comma or in your part name!
config SHIELD_PEACE_AND_LOVE_LEFT
    def_bool $(shields_list_contains,peace_and_love_left)

# No whitespace after the comma or in your part name!
config SHIELD_PEACE_AND_LOVE_RIGHT
    def_bool $(shields_list_contains,peace_and_love_right)
```
